## main/Kconfig.projbuild
```kconfig
# SPDX-FileCopyrightText: 2026 The Fisher Slopworks Co
# SPDX-License-Identifier: AGPL-3.0-or-later

menu "CO2 Exporter Configuration"

    menu "WiFi"

        config WIFI_SETUP_GRACE_SECONDS
            int "Seconds offline before opening the setup portal"
            default 30
            range 5 600
            help
                WiFi credentials are stored in NVS and entered through the web
                setup page — they are not baked into the firmware.

                After a disconnect (or on a fresh device with no stored
                credentials) the device keeps retrying the saved network for
                this many seconds before raising the SoftAP setup portal. The
                portal runs alongside the background reconnect attempts, so a
                transient outage of the real network recovers on its own and the
                portal disappears again once the device reconnects.

    endmenu

    config HOSTNAME
        string "Hostname"
        default "co2meter"
        help
            Hostname advertised to the network (DHCP/mDNS). Also the base for
            the setup SoftAP name ("<hostname>-setup"). Defaults to "co2meter".

    config DEVICE_NAME
        string "Device label exported in metrics"
        default "daget"
        help
            Value of the device="..." label on every exported metric.

    menu "GPIO pins"

        config PIN_CLK
            int "ZG-01 clock GPIO (CLK)"
            default 18
            help
                Connected to the sensor's C (clock) line. Falling-edge
                interrupt source. GPIO18 is a regular GPIO (not a strapping
                pin), so the sensor's clock idle level can't interfere with
                boot. Avoid the strapping pins (GPIO0/2/5/12/15) here, since
                the sensor drives this line continuously — including during
                reset.

        config PIN_DATA
            int "ZG-01 data GPIO (DATA)"
            default 19
            help
                Connected to the sensor's D (data) line. If you get no
                readings, try swapping CLK and DATA — some ZG-01 units wire
                the connector D, C, G instead of C, D, G.

    endmenu

    menu "Status LED"

        config STATUS_LED_ENABLE
            bool "Enable on-board status LED"
            default y
            help
                Blink an LED to show boot/runtime state: solid while booting,
                fast blink while connecting to WiFi, a double blink once online
                but waiting for the sensor, and a brief heartbeat when sensor
                data is flowing. Disable to leave the GPIO untouched.

        config PIN_STATUS_LED
            int "Status LED GPIO"
            depends on STATUS_LED_ENABLE
            default 2
            help
                GPIO driving the status LED. Defaults to GPIO2, the on-board
                LED on most ESP32 DevKit boards. GPIO2 is a strapping pin but
                is safe to drive as an output after boot.

        config STATUS_LED_ACTIVE_LOW
            bool "Status LED is active-low"
            depends on STATUS_LED_ENABLE
            default n
            help
                Enable if the LED lights when the GPIO is driven low (common on
                boards where the LED sits between VCC and the pin).

    endmenu

    menu "Factory reset button"

        config RESET_BUTTON_ENABLE
            bool "Enable long-press factory reset button"
            default y
            help
                Hold a push button (the on-board BOOT button on most ESP32
                DevKit boards) to erase the stored WiFi credentials and reboot
                into the setup portal. The button is sampled only at runtime, so
                it does not affect GPIO0's boot strapping.

        config PIN_RESET_BUTTON
            int "Factory reset button GPIO"
            depends on RESET_BUTTON_ENABLE
            default 0
            help
                GPIO of an active-low push button (pressed = low). Defaults to
                GPIO0, the on-board BOOT button. An internal pull-up is enabled,
                so no external resistor is needed.

        config RESET_HOLD_SECONDS
            int "Seconds to hold for factory reset"
            depends on RESET_BUTTON_ENABLE
            default 3
            range 1 10
            help
                How long the button must be held continuously before the reset
                fires. Long enough to avoid an accidental tap.

    endmenu

    menu "OTA update (firmware over WiFi)"

        config OTA_ENABLE
            bool "Enable OTA firmware update endpoint"
            default y
            help
                Adds a /update page and POST endpoint so new firmware can be
                flashed over WiFi. Requires an OTA-capable partition table with
                two app slots (see partitions.csv) and a 4MB flash.

        config OTA_PASSWORD
            string "OTA update password"
            depends on OTA_ENABLE
            default "changeme"
            help
                Must be sent in the X-OTA-Password header for an upload to be
                accepted. CHANGE THIS — anyone on the network who knows it can
                replace the device firmware.

    endmenu

endmenu
```

## sdkconfig.defaults
```kconfig
# SPDX-FileCopyrightText: 2026 The Fisher Slopworks Co
# SPDX-License-Identifier: AGPL-3.0-or-later

# Project-wide default sdkconfig values.
# Run `idf.py menuconfig` to change CO2 Exporter settings (WiFi, pins).

# app_main calls into nvs/wifi/httpd setup — give it a little headroom.
CONFIG_ESP_MAIN_TASK_STACK_SIZE=4096

# HTTP server: a handful of URI handlers, plus the X-OTA-Password header.
CONFIG_HTTPD_MAX_REQ_HDR_LEN=1024

# --- OTA (firmware over WiFi) ---
# Two-app-slot partition table (see partitions.csv).
CONFIG_PARTITION_TABLE_CUSTOM=y
CONFIG_PARTITION_TABLE_CUSTOM_FILENAME="partitions.csv"
# OTA needs a 4MB module (two ~2MB app slots). Set this to match your board;
# for a 2MB module a tighter partitions.csv is required instead.
CONFIG_ESPTOOLPY_FLASHSIZE_4MB=y
CONFIG_ESPTOOLPY_FLASHSIZE="4MB"
# Auto-rollback: a freshly flashed image must confirm itself at runtime or the
# bootloader reverts to the previous one on the next reboot.
CONFIG_BOOTLOADER_APP_ROLLBACK_ENABLE=y
```
